/*
 * Corne Choc Pro BT – 40-key urob keymap
 *
 * Layout (five_col_layout, 40 physical keys):
 *
 *  ╭──────────────────────────╮ ╭──╮ ╭──╮ ╭──────────────────────────╮
 *  │  0   1   2   3   4       │ │ 5│ │ 6│ │  7   8   9  10  11       │
 *  │ LT4 LT3 LT2 LT1 LT0     │ │LI│ │RI│ │ RT0 RT1 RT2 RT3 RT4      │
 *  ├──────────────────────────┤ ├──┤ ├──┤ ├──────────────────────────┤
 *  │ 12  13  14  15  16       │ │17│ │18│ │ 19  20  21  22  23       │
 *  │ LM4 LM3 LM2 LM1 LM0     │ │LI│ │RI│ │ RM0 RM1 RM2 RM3 RM4      │
 *  ├──────────────────────────╯           ╰──────────────────────────┤
 *  │ 24  25  26  27  28                    29  30  31  32  33         │
 *  │ LB4 LB3 LB2 LB1 LB0                 RB0 RB1 RB2 RB3 RB4        │
 *  ╰──────────────╮ 34  35  36           37  38  39 ╭────────────────╯
 *                 │LH2 LH1 LH0          RH0 RH1 RH2│
 *                 ╰───────────────────────────────╯
 */

/* Board-specific: enable 3-thumb mode in base.keymap before THUMBS is evaluated */
#define LH2 34
#define RH2 39

/* 40-key position labels */
#define LT4  0
#define LT3  1
#define LT2  2
#define LT1  3
#define LT0  4
#define LI0  5
#define RI0  6
#define RT0  7
#define RT1  8
#define RT2  9
#define RT3 10
#define RT4 11
#define LM4 12
#define LM3 13
#define LM2 14
#define LM1 15
#define LM0 16
#define LI1 17
#define RI1 18
#define RM0 19
#define RM1 20
#define RM2 21
#define RM3 22
#define RM4 23
#define LB4 24
#define LB3 25
#define LB2 26
#define LB1 27
#define LB0 28
#define RB0 29
#define RB1 30
#define RB2 31
#define RB3 32
#define RB4 33
#define LH1 35
#define LH0 36
#define RH0 37
#define RH1 38

/* Enable wireless BT bindings in base.keymap */
#define CONFIG_WIRELESS

/*
 * ZMK_BASE_LAYER override for 40-key board.
 * base.keymap passes: LT(5), RT(5), LM(5), RM(5), LB(5), RB(5), LH(2), RH(2)
 * We insert the 4 inner keys and the 2 outer thumbs around those groups.
 *
 * Inner-top keys:  C_MUTE (left) / C_PP  (right)
 * Inner-mid keys:  LALT   (left) / RALT  (right)
 * Outer thumbs:    LGUI   (left) / smart_mouse (right)
 */
#define ZMK_BASE_LAYER(name, LT, RT, LM, RM, LB, RB, LH, RH) \
    ZMK_LAYER(name,                                            \
        LT &kp C_MUTE &kp C_PP RT                             \
        LM &kp LALT   &kp RALT RM                             \
        LB RB                                                  \
        &kp LGUI LH RH &smart_mouse                           \
    )

#include "../../../base.keymap"

/ {
    chosen {
        zmk,physical-layout = &five_col_layout;
    };
};
